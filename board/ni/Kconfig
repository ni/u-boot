## board/ni/Kconfig
```kconfig
if NIZYNQ
choice
	prompt "NI Zynq board select"

config TARGET_NI_9149
	bool "NI 9149"
	select CRIO
	select NI9149

config TARGET_NI_9149_MFG
	bool "NI 9149 manufacturing U-Boot"
	select MFG
	select CRIO
	select NI9149

config TARGET_NI_9147
	bool "NI 9147"
	select CRIO
	select NI9147

config TARGET_NI_9147_MFG
	bool "NI 9147 manufacturing U-Boot"
	select MFG
	select CRIO
	select NI9147

config TARGET_NI_7931
	bool "NI 7931"
	select SBRIO
	select NI7931

config TARGET_NI_7931_MFG
	bool "NI 7931 manufacturing U-Boot"
	select SBRIO
	select MFG
	select NI7931

config TARGET_NI_7932
	bool "NI 7932"
	select SBRIO
	select NI7932

config TARGET_NI_7932_MFG
	bool "NI 7932 manufacturing U-Boot"
	select SBRIO
	select MFG
	select NI7932

config TARGET_NI_7935
	bool "NI 7935"
	select SBRIO
	select NI7935

config TARGET_NI_7935_MFG
	bool "NI 7935 manufacturing U-Boot"
	select SBRIO
	select MFG
	select NI7935

config TARGET_NI_CRIO9063
	bool "NI cRIO-9063"
	select CRIO
	select CRIO9063

config TARGET_NI_CRIO9063_MFG
	bool "NI cRIO-9063 manufacturing U-Boot"
	select MFG
	select CRIO
	select CRIO9063

config TARGET_NI_CRIO9064
	bool "NI cRIO-9064"
	select CRIO
	select CRIO9064

config TARGET_NI_CRIO9064_MFG
	bool "NI cRIO-9064 manufacturing U-Boot"
	select MFG
	select CRIO
	select CRIO9064

config TARGET_NI_CRIO9065
	bool "NI cRIO-9065"
	select CRIO
	select CRIO9065

config TARGET_NI_CRIO9065_MFG
	bool "NI cRIO-9065 manufacturing U-Boot"
	select MFG
	select CRIO
	select CRIO9065

config TARGET_NI_CRIO9066
	bool "NI cRIO-9066"
	select CRIO
	select CRIO9066

config TARGET_NI_CRIO9066_MFG
	bool "NI cRIO-9066 manufacturing U-Boot"
	select MFG
	select CRIO
	select CRIO9066

config TARGET_NI_CRIO9067
	bool "NI cRIO-9067"
	select CRIO
	select CRIO9067

config TARGET_NI_CRIO9067_MFG
	bool "NI cRIO-9067 manufacturing U-Boot"
	select MFG
	select CRIO
	select CRIO9067

config TARGET_NI_CRIO9068
	bool "NI cRIO-9068"
	select CRIO
	select CRIO9068

config TARGET_NI_CRIO9068_MFG
	bool "NI cRIO-9068 manufacturing U-Boot"
	select MFG
	select CRIO
	select CRIO9068

config TARGET_NIMYRIO
	bool "NI myRIO"
	select MYRIO

config TARGET_NIMYRIO_MFG
	bool "NI myRIO manufacturing U-Boot"
	select MFG
	select MYRIO

config TARGET_NIMYRIO_BO
	bool "NI myRIO board only"
	select MYRIO
	select MYRIO_BO

config TARGET_ELVISRIOCM
	bool "NI ELVIS RIO Control Module"
	select MYRIO
	select ELVISRIOCM

config TARGET_ELVISRIOCM_MFG
	bool "NI ELVIS RIO Control Module manufacturing U-Boot"
	select MFG
	select MYRIO
	select ELVISRIOCM

config TARGET_ROBORIO
	bool "NI roboRIO"
	select MYRIO
	select ROBORIO

config TARGET_ROBORIO_MFG
	bool "NI roboRIO manufacturing U-Boot"
	select MFG
	select MYRIO
	select ROBORIO

config TARGET_NI_SBRIO9607
	bool "NI sbRIO-9607"
	select CRIO
	select SBRIO9607

config TARGET_NI_SBRIO9607_MFG
	bool "NI sbRIO-9607 manufacturing U-Boot"
	select MFG
	select CRIO
	select SBRIO9607

config TARGET_NI_SBRIO9627
	bool "NI sbRIO-9627"
	select CRIO
	select SBRIO9627

config TARGET_NI_SBRIO9627_MFG
	bool "NI sbRIO-9627 manufacturing U-Boot"
	select MFG
	select CRIO
	select SBRIO9627

config TARGET_NI_SBRIO9637
	bool "NI sbRIO-9637"
	select CRIO
	select SBRIO9637

config TARGET_NI_SBRIO9637_MFG
	bool "NI sbRIO-9637 manufacturing U-Boot"
	select MFG
	select CRIO
	select SBRIO9637

config TARGET_NI_SBRIO9651
	bool "NI sbRIO 9651"
	select SBRIO
	select SBRIO9651SOM

config TARGET_NI_SBRIO9651_MFG
	bool "NI sbRIO 9651 manufacturing U-Boot"
	select SBRIO
	select MFG
	select SBRIO9651SOM

config TARGET_NI_ELVISIII_BO
	bool "NI ELVIS III Board Only"
	select CRIO
	select ELVISIII_BO

config TARGET_NI_ELVISIII_PLUS
	bool "NI ELVIS III Plus"
	select CRIO
	select ELVISIII_PLUS

config TARGET_NI_ELVISIII_MFG
	bool "NI ELVIS III manufacturing U-Boot"
	select MFG
	select CRIO
	select ELVISIII_BO
endchoice

config DEVICE_CODE
	string "NI Zynq PS device id"

config FPGA_DEVICE_CODE
	string "NI Zynq FPGA device id"
	default DEVICE_CODE

config NI_USB_PID
	string "NI USB product id"
	default "0x762F" if MYRIO
	default "0x770D"

config NI_USB_VID
	string "NI USB vendor id"
	default "0x3923"

config DEVICE_DESC
	string "NI product description"

config PREFIXED_DEVICE_DESC
	string "Prefix devices description"

config TARGET_CLASS
	string "NI product family"
	default "cRIO" if CRIO || MYRIO
	default "FlexRIO" if SBRIO

config NI_BOARD_NAME
	string "NI product name"
	default DEVICE_DESC

config NI_BOARD_NAME_PREFIX
	string "Prefix of the board name"
	default "Prototype" if PROTO

config NI_BOARD_NAME_SUFFIX
	string "Suffix of the board name"
	default " Manufacturing" if MFG

config CONSOLE_LINUX_DEV
	string "Console device for Linux"
	default "ttyS0"

config CONSOLE_UBOOT_DEV
	string "Console device for U-boot"
	default "serial@80000000"

config SYS_BOARD
	default "criozynq" if CRIO
	default "myrio" if MYRIO
	default "somzynq" if SBRIO

config SYS_VENDOR
	default "ni"

config SYS_SOC
	default "zynq"

config SYS_CONFIG_NAME
	default "nicriozynq" if CRIO
	default "nimyrio" if MYRIO
	default "nisomzynq" if SBRIO

config SYS_TEXT_BASE
	default 0x4000000

config MTD_UBOOT_OFFSET
	hex "U-boot MTD offset"
	default 0x20000

config MTD_RESERVE_END
	hex "MTD Reserved End"
	default 0x80000

config BOARD_SIZE_LIMIT
	hex "Board Size Limit"
	default 0x80000 if CRIO_MEM256 || CRIO_ENETEXP
	default 0x100000

config BOOT_BIN_SIZE_LIMIT
	hex "BOOT.bin max file size"
	default 0x120000

config BOOTFS_VOLUME_SIZE
	hex "BOOTFS UBI volume size"
	default 0x3600000

config BACKUP_PAGE
	hex "NAND backup page"
	default 0xB1F800

config BACKUP_SERIAL_OFFSET
	hex "Serial number backup page offset"
	default 0x7f0 if CRIO || MYRIO
	default 0x7e4 if SBRIO

config BACKUP_USBGADGETETHADDR_OFFSET
	hex "USB Gadget Ethernet MAC backup page offset"
	default 0x7ea if CRIO || MYRIO
	default 0x7f4 if SBRIO

config BACKUP_ETHADDR_OFFSET
	hex "Primary Ethernet MAC backup page offset"
	default 0x7f4 if CRIO || MYRIO
	default 0x7e8 if SBRIO

config BACKUP_ETH1ADDR_OFFSET
	hex "Secondary Ethernet MAC backup page offset"
	default 0x7fa if CRIO || MYRIO
	default 0x7ee if SBRIO

config MFG
	bool "Manufacturing U-Boot"
	select NAND_BBT_NO_MARK


source "board/ni/criozynq/Kconfig"
source "board/ni/myrio/Kconfig"
source "board/ni/somzynq/Kconfig"

endif
```

## board/ni/criozynq/Kconfig
```kconfig
if CRIO
config CRIO_GEN2
	bool "cRIO 2nd generation"

config CRIO_MEM256
	bool "cRIO with 256MB RAM"

config CRIO_MEM512
	bool "cRIO with 512MB RAM"

config CRIO_ENETEXP
	bool "cRIO Ethernet Expansion"

config CRIO_SBRIO96X7
	bool "sbRIO96X7 use cRIO as a base"

config CRIO_HALF_BOARD
	bool "sbRIO Half Board"

config CRIO_FULL_BOARD
	bool "sbRIO Full Board"

config CRIO_RMC
	bool "sbRIO RMC"

config ELVISIII
	bool "ELVIS III targets"

config NI9147
	bool "NI 9147 target"
	select CRIO_GEN2
	select CRIO_ENETEXP

config NI9149
	bool "NI 9149 target"
	select CRIO_GEN2
	select CRIO_ENETEXP

config CRIO9063
	bool "cRIO-9063 target"
	select CRIO_GEN2
	select CRIO_MEM256

config CRIO9064
	bool "cRIO-9064 target"
	select CRIO_GEN2
	select CRIO_MEM512

config CRIO9065
	bool "cRIO-9065 target"
	select CRIO_GEN2
	select CRIO_MEM512

config CRIO9066
	bool "cRIO-9066 target"
	select CRIO_GEN2
	select CRIO_MEM256

config CRIO9067
	bool "cRIO-9067 target"
	select CRIO_GEN2
	select CRIO_MEM512

config CRIO9068
	bool "cRIO-9068 target"

config SBRIO9607
	bool "sbRIO-9607 target"
	select CRIO_RMC
	select CRIO_SBRIO96X7
	select CRIO_HALF_BOARD

config SBRIO9627
	bool "sbRIO-9627 target"
	select CRIO_RMC
	select CRIO_SBRIO96X7
	select CRIO_FULL_BOARD

config SBRIO9637
	bool "sbRIO-9637 target"
	select CRIO_SBRIO96X7
	select CRIO_FULL_BOARD

config I2C_CPLD_ADDR
	hex "CPLD I2C Address"
	default 0x40

if !ELVISIII
config I2C_RTC_ADDR
	hex "RTC I2C Address"
	default 0x68
endif

endif

config CRIO
	bool "cRIO derivatives"
	select CLK_ZYNQ if DM_CLK
	select ZYNQ_GPIO
	select MACB if DM_ETH
	select MACB_ZYNQ if MACB
	select NI_USB_PID if ELVISIII || CRIO_GEN2 || CRIO_SBRIO96X7
	select NI_USB_VID if ELVISIII || CRIO_GEN2 || CRIO_SBRIO96X7
	select MTD_UBOOT_OFFSET
	select MTD_RESERVE_END
	select BOARD_SIZE_LIMIT
	select BOOT_BIN_SIZE_LIMIT
	select BOOTFS_VOLUME_SIZE
	select BACKUP_PAGE
	select BACKUP_SERIAL_OFFSET
	select BACKUP_USBGADGETETHADDR_OFFSET
	select BACKUP_ETHADDR_OFFSET
	select BACKUP_ETH1ADDR_OFFSET
	select I2C_CPLD_ADDR
	select I2C_RTC_ADDR if !ELVISIII
	select SILENT_CONSOLE
	select SILENT_U_BOOT_ONLY
	select SILENT_CONSOLE_UPDATE_ON_SET
```

## board/ni/myrio/Kconfig
```kconfig
if MYRIO
config MYRIO_BO
	bool "myRIO board only"

config NIMYRIO
	bool "myRIO board"
	select NI_ME256

config ROBORIO
	bool "roboRIO"
	select NI_MEM256

config ELVISRIOCM
	bool "ELVIS RIO Control Module"
	select NI_MEM256

config ROBORIO2
	bool "roboRIO 2.0"
	select NI_MEM512
endif

config MYRIO
	bool "myRIO derivatives"
	select CLK_ZYNQ if DM_CLK
	select ZYNQ_GPIO
	select MACB if DM_ETH
	select MACB_ZYNQ if MACB
	select NI_USB_PID
	select NI_USB_VID
	select MTD_UBOOT_OFFSET
	select MTD_RESERVE_END
	select BOARD_SIZE_LIMIT
	select BOOT_BIN_SIZE_LIMIT
	select BOOTFS_VOLUME_SIZE
	select BACKUP_PAGE
	select BACKUP_SERIAL_OFFSET
	select BACKUP_USBGADGETETHADDR_OFFSET
	select BACKUP_ETHADDR_OFFSET
	select BACKUP_ETH1ADDR_OFFSET
	select I2C_CPLD_ADDR
	select SILENT_CONSOLE
	select SILENT_U_BOOT_ONLY
	select SILENT_CONSOLE_UPDATE_ON_SET
```

## board/ni/somzynq/Kconfig
```kconfig
if SBRIO
config NI793X
	bool "NI 793X target"

config NI7931
	bool "NI 7931 target"
	select NI793X

config NI7932
	bool "NI 7932 target"
	select NI793X

config NI7935
	bool "NI 7935 target"
	select NI793X

config SBRIO9651SOM
	bool "sbRIO-9651 SOM target"

config BACKUP_CCA_SERIAL_OFFSET
	hex "Backup page for CCA Serial Number"
	default 0x7e0

config BACKUP_ETH3ADDR_OFFSET
	hex "Backup page for WiFi MAC"
	default 0x7fa

endif

config SBRIO
	bool "sbRIO derivatives"
	select CLK_ZYNQ if DM_CLK
	select NI_USB_PID
	select NI_USB_VID
	select MTD_UBOOT_OFFSET
	select MTD_RESERVE_END
	select BOARD_SIZE_LIMIT
	select BOOT_BIN_SIZE_LIMIT
	select BOOTFS_VOLUME_SIZE
	select BACKUP_PAGE
	select BACKUP_CCA_SERIAL_OFFSET
	select BACKUP_SERIAL_OFFSET
	select BACKUP_USBGADGETETHADDR_OFFSET
	select BACKUP_ETHADDR_OFFSET
	select BACKUP_ETH1ADDR_OFFSET
	select BACKUP_ETH3ADDR_OFFSET
```

## configs/ni_elvisiii_bo_defconfig
```kconfig
CONFIG_ARM=y
CONFIG_ARCH_ZYNQ=y
CONFIG_NIZYNQ=y
CONFIG_FIT=y
CONFIG_FIT_VERBOSE=y
CONFIG_FIT_SIGNATURE=y
# CONFIG_CMD_XIMG is not set
CONFIG_CMD_PING=y
# CONFIG_CMD_SETGETDCR is not set
CONFIG_SYS_PROMPT="U-Boot> "
CONFIG_CMD_DHCP=y
CONFIG_CMD_LINK_LOCAL=y
CONFIG_NETCONSOLE=y
CONFIG_NULLDEV_SERIAL=y
CONFIG_CMD_I2C=y
CONFIG_CMD_NAND=y
# CONFIG_CMD_FLASH is not set
# CONFIG_CMD_IMLS is not set
CONFIG_LIB_RAND=y # required by CONFIG_CMD_LINK_LOCAL
CONFIG_TARGET_NI_ELVISIII_BO=y
CONFIG_CMD_USB=y
CONFIG_DM_USB=y
CONFIG_USB=y
# CONFIG_DISK is not set
CONFIG_ZYNQ_SDHCI=y
CONFIG_CMD_MMC=y
CONFIG_CMD_EXT2=y
CONFIG_DEFAULT_DEVICE_TREE="ni-elvisiii"
CONFIG_DM_I2C=y
CONFIG_SYS_I2C_CADENCE=y
# CONFIG_DISPLAY_CPUINFO is not set
CONFIG_OF_CONTROL=y
CONFIG_DM_ETH=y
CONFIG_CLK_ZYNQ=y
CONFIG_DM_CLK=y
CONFIG_HUSH_PARSER=y
CONFIG_DM=y
CONFIG_DM_STDIO=y
CONFIG_DM_USB=y
CONFIG_CMD_UBI=y
CONFIG_CLK=y
```

## configs/ni_elvisiii_mfg_defconfig
```kconfig
CONFIG_ARM=y
CONFIG_ARCH_ZYNQ=y
CONFIG_NIZYNQ=y
CONFIG_FIT=y
CONFIG_FIT_VERBOSE=y
CONFIG_FIT_SIGNATURE=y
# CONFIG_CMD_XIMG is not set
CONFIG_CMD_PING=y
# CONFIG_CMD_SETGETDCR is not set
CONFIG_CONSOLE_LINUX_DEV="ttyPS0"
CONFIG_CONSOLE_UBOOT_DEV="serial@e0001000"
CONFIG_SYS_PROMPT="U-Boot> "
CONFIG_CMD_DHCP=y
CONFIG_CMD_LINK_LOCAL=y
CONFIG_NETCONSOLE=y
CONFIG_NULLDEV_SERIAL=y
CONFIG_CMD_I2C=y
CONFIG_CMD_NAND=y
# CONFIG_CMD_FLASH is not set
# CONFIG_CMD_IMLS is not set
CONFIG_LIB_RAND=y # required by CONFIG_CMD_LINK_LOCAL
CONFIG_TARGET_NI_ELVISIII_MFG=y
CONFIG_DEVICE_CODE="7928"
CONFIG_DEVICE_DESC="ELVIS III"
CONFIG_PREFIXED_DEVICE_DESC="NI ELVIS III"
CONFIG_NI_USB_PID="0x762F"
CONFIG_CMD_USB=y
CONFIG_USB=y
# CONFIG_DISK is not set
CONFIG_ZYNQ_SDHCI=y
CONFIG_CMD_MMC=y
CONFIG_CMD_EXT2=y
CONFIG_CMD_INI=y
CONFIG_DEFAULT_DEVICE_TREE="ni-elvisiii"
CONFIG_DM_I2C=y
CONFIG_SYS_I2C_CADENCE=y
# CONFIG_DISPLAY_CPUINFO is not set
CONFIG_CLK_ZYNQ=y
CONFIG_HUSH_PARSER=y
CONFIG_DM_STDIO=y
CONFIG_CMD_UBI=y
```

## configs/ni_sbrio9627_defconfig
```kconfig
CONFIG_ARM=y
CONFIG_NIZYNQ=y
CONFIG_FIT=y
CONFIG_FIT_VERBOSE=y
CONFIG_FIT_SIGNATURE=y
# CONFIG_CMD_XIMG is not set
CONFIG_CMD_PING=y
# CONFIG_CMD_SETGETDCR is not set
CONFIG_SYS_PROMPT="U-Boot> "
CONFIG_CMD_DHCP=y
CONFIG_CMD_LINK_LOCAL=y
CONFIG_NETCONSOLE=y
CONFIG_NULLDEV_SERIAL=y
CONFIG_CMD_I2C=y
CONFIG_CMD_NAND=y
# CONFIG_CMD_FLASH is not set
# CONFIG_CMD_IMLS is not set
CONFIG_LIB_RAND=y # required by CONFIG_CMD_LINK_LOCAL
CONFIG_TARGET_NI_SBRIO9627=y
CONFIG_DEVICE_CODE="77D5"
CONFIG_DEVICE_DESC="sbRIO-9627"
CONFIG_PREFIXED_DEVICE_DESC="NI sbRIO-9627"
CONFIG_SYS_NS16550=y
CONFIG_CMD_USB=y
CONFIG_DM_USB=y
CONFIG_USB=y
# CONFIG_DISK is not set
CONFIG_ZYNQ_SDHCI=y
CONFIG_CMD_MMC=y
CONFIG_CMD_EXT2=y
CONFIG_DEFAULT_DEVICE_TREE="ni-sbrio-9627"
CONFIG_DM_I2C=y
CONFIG_SYS_I2C_CADENCE=y
CONFIG_DM_RTC=y
# CONFIG_DISPLAY_CPUINFO is not set
CONFIG_OF_CONTROL=y
CONFIG_DM_ETH=y
CONFIG_CLK_ZYNQ=y
CONFIG_DM_CLK=y
CONFIG_HUSH_PARSER=y
CONFIG_DM=y
CONFIG_DM_STDIO=y
CONFIG_DM_USB=y
CONFIG_CMD_UBI=y
CONFIG_CLK=y
CONFIG_CMD_MEMTEST=y
```

## configs/ni_sbrio9651_mfg_defconfig
```kconfig
CONFIG_ARM=y
CONFIG_NIZYNQ=y
CONFIG_FIT=y
CONFIG_FIT_VERBOSE=y
CONFIG_FIT_SIGNATURE=y
# CONFIG_CMD_XIMG is not set
CONFIG_CMD_PING=y
# CONFIG_CMD_SETGETDCR is not set
CONFIG_SYS_PROMPT="U-Boot> "
CONFIG_ZYNQ_GEM=y
CONFIG_CMD_DHCP=y
CONFIG_CMD_LINK_LOCAL=y
CONFIG_NETCONSOLE=y
CONFIG_NULLDEV_SERIAL=y
CONFIG_CMD_I2C=y
CONFIG_CMD_NAND=y
# CONFIG_CMD_FLASH is not set
# CONFIG_CMD_IMLS is not set
CONFIG_LIB_RAND=y # required by CONFIG_CMD_LINK_LOCAL
CONFIG_TARGET_NI_SBRIO9651_MFG=y
CONFIG_SYS_NS16550=y
CONFIG_CMD_USB=y
CONFIG_DM_USB=y
CONFIG_USB=y
# CONFIG_DISK is not set
CONFIG_ZYNQ_SDHCI=y
CONFIG_CMD_MMC=y
CONFIG_CMD_EXT2=y
CONFIG_CMD_GPIO=y
```
